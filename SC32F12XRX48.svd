# SC32F12XRX48 register map
File version: 1.0
SC32F12X
CPU: CM0+ r0p1, little endian, MPU, no FPU, 4 interrupt priority bits
Registers are 32-bit, read-write, reset 0x0 unless marked. A register's access mark holds for its fields unless they carry their own. Offsets are from the block's base; lines under a group give offsets from that group; [hi:lo] are bit positions; {n}, {i} and the like mark numbered series; 'fields as' and 'values as' point back to an identical list; <NAME> marks a mode.

## Memory map
0x40000330 WDT size 0x14 — Watchdog
0x400003C0 IAP size 0x1C
0x40002000 CRC size 0x10 — Cyclic redundancy check calculation unit
0x40003000 RCC_AHB size 0x5C — System configuration controller
0x40010800 DMA0 size 0x14 — DMA0 controller
0x40010840 DMA1 size 0x14 — DMA1 controller
0x40011000 GPIOA size 0x80 — General-purpose I/Os A
0x40011100 GPIOB size 0x80 — General-purpose I/Os B
0x40011200 GPIOC size 0x80 — General-purpose I/Os C
0x40011800 INT size 0x100 — Interrupt/event controller
0x40020000 RCC_APB0 size 0x8 — System configuration controller
0x40020020 UART0 size 0x1C — Universal synchronous asynchronous receiver transmitter
0x40020040 SPI0 size 0x1C — Serial peripheral interface/Inter-IC sound
0x40020060 TWI0 size 0x1C — Inter-integrated circuit 0
0x40020080 UART1 size 0x1C — Universal synchronous asynchronous receiver transmitter
0x400200A0 UART5 size 0x1C — Universal synchronous asynchronous receiver transmitter
0x40020100 TIM0 size 0x40 — General purpose timers
0x40020140 TIM1 size 0x40 — General-purpose-timers
0x40020180 TIM2 size 0x40 — General-purpose-timers
0x400201C0 TIM3 size 0x40 — General-purpose-timers
0x40020200 PWM0 size 0x50 — Pulse Width Modulation 0 registers
0x40021000 RCC_APB1 size 0x8 — System configuration controller
0x40021020 UART2 size 0x1C — Universal synchronous asynchronous receiver transmitter
0x40021040 SPI1 size 0x1C — Serial peripheral interface/Inter-IC sound
0x40021060 TWI1 size 0x1C — Inter-integrated circuit 1
0x40021080 UART4 size 0x1C — Universal synchronous asynchronous receiver transmitter
0x400210A0 SPI2 size 0x1C — Serial peripheral interface/Inter-IC sound
0x40021100 TIM4 size 0x40 — General-purpose-timers
0x40021140 TIM5 size 0x40 — General-purpose-timers
0x40021180 TIM6 size 0x40 — General purpose timers
0x400211C0 TIM7 size 0x40 — General purpose timers
0x40022000 RCC_APB2 size 0x8 — System configuration controller
0x40022020 UART3 size 0x1C — Universal synchronous asynchronous receiver transmitter
0x40022100 BTM size 0xC
0x40022110 ADC size 0x1C — Analog to Digital Converter instance
0x40022130 CMP size 0xC — Analog comparator
0x40022140 OP size 0x1C — operational amplifier
0x40022200 TK size 0x20 — TK touch
0x40022280 LCD_LED size 0x14
0x40022300 LEDPWM size 0x110 — LED Pulse Width Modulation 1 registers

## Interrupts
0 INT0 (INT) — External Interrupt line 0 global interrupt
1 INT1_7 (INT) — External Interrupt line 1 to 7 global interrupt
2 INT8_11 (INT) — External Interrupt line 8 to 11 global interrupt
3 INT12_15 (INT) — External Interrupt line 12 to 15 global interrupt
4 RCC (RCC_AHB) — RCC Stop the vibration global interrupt
6 BTM — BTM global interrupt
7 UART0_2_4 (UART0) — UART0_2_4 global interrupt
8 UART1_3_5 (UART1) — UART1_3_5 global interrupt
9 SPI0 — SPI0 global interrupt
10 SPI1_2 (SPI1) — SPI1 and SPI2 global interrupt
11 DMA_Channel0 (DMA0) — DMA channel 0 interrupt
12 DMA_Channel1 (DMA1) — DMA channel 1 interrupt
15 TIM0 — TIM0 global interrupt
16 TIM1 — TIM1 global interrupt
17 TIM2 — TIM2 global interrupt
18 TIM3 — TIM3 global interrupt
19 TIM4_5 (TIM4) — TIM4_5 global interrupt
20 TIM6_7 (TIM6) — TIM6_7 global interrupt
21 PWM0 — Pulse Width Modulation 0 global interrupt
22 LEDPWM — LED Pulse Width Modulation 1 global interrupt
23 TWI0 — TWI0 global interrupt
24 TWI1 — TWI1 global interrupt
29 ADC — ADC global interrupts
30 CMP — CMP global interrupt
31 TK — TK interrupt

## WDT — Watchdog
Base 0x40000330
0x0C WDTCON — Control register
  [0] CLRWDT — Clean up Watchdog
0x10 WDTCFG — Configuration register
  [2:0] WDTCKS — Timer base

## Notices in the file
Copyright (c) 2022 SinOneMicroelectronics.
